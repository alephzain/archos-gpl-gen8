## buildroot/package/bluez-libs/Config.in
```kconfig
config BR2_PACKAGE_BLUEZ_LIBS
	bool "bluetooth protocol stack library (V3)"
	default n
	select BR2_PACKAGE_DBUS
	help
	  Official Linux Bluetooth protocol stack

	  http://www.bluez.org
```

## buildroot/package/bluez-utils/Config.in
```kconfig
config BR2_PACKAGE_BLUEZ_UTILS
	bool "bluetooth protocol stack utils (V3)"
	default n
	select BR2_PACKAGE_DBUS
	select BR2_PACKAGE_BLUEZ_LIBS
	help
	  Official Linux Bluetooth protocol stack

	  http://www.bluez.org
```

## buildroot/package/bluez/Config.in
```kconfig
config BR2_PACKAGE_BLUEZ
	bool "bluetooth protocol stack"
	default n
	select BR2_PACKAGE_DBUS
	help
	  Official Linux Bluetooth protocol stack

	  http://www.bluez.org
```

## buildroot/package/bonnie/Config.in
```kconfig
config BR2_PACKAGE_BONNIE
	bool "bonnie++"
	default n
	help
	  block device and filesystem performance tester
```

## buildroot/package/djmount/Config.in
```kconfig
config BR2_PACKAGE_DJMOUNT
	bool "djmount"
	default n
	select BR2_PACKAGE_FUSE
	select BR2_PACKAGE_LIBUPNP
	help
	  djmount - mount MediaServers content as a Linux filesystem.
	  Created 23/04/2005, Rémi Turboult <r3mi@users.sourceforge.net>
	  
	  djmount is a UPnP AV client. It mounts as a Linux filesystem (using FUSE)
	  the media content of compatible UPnP AV devices.
	  
	  djmount discovers automatically all UPnP AV Media Servers on the network,
	  and make the content available in a directory tree. All shared files 
	  (e.g. Audio or Video files) are directly visible and can be played using 
	  your favorite media player.
	  
	  djmount is free software, licensed under the terms of the GNU General Public
	  License (GNU GPL).
```

## buildroot/package/dvb_usb_dib0700_fw/Config.in
```kconfig
config BR2_PACKAGE_DVB_USB_DIB0700_FW
	bool "dvb-usb-dib0700 firmware"
	default n
	help
	  Firmware for the Dibcom DIB0700 DVB-T usb module
```

## buildroot/package/dvbsnoop/Config.in
```kconfig
config BR2_PACKAGE_DVBSNOOP
bool "dvbsnoop"
	default y
	help
		A DVB stream analyzer : http://dvbsnoop.sourceforge.net	
```

## buildroot/package/e_dbus/Config.in
```kconfig
config BR2_PACKAGE_E_DBUS
	bool "e_dbus"
	default n
	help
	  E_Dbus is the Enlightenment library that interfaces to DBUS.

	  http://www.enlightenment.org/
```

## buildroot/package/ecore/Config.in
```kconfig
config BR2_PACKAGE_ECORE
	bool "ecore"
	default n
	select BR2_PACKAGE_ICONV
	select BR2_PACKAGE_TSLIB
	select BR2_PACKAGE_EINA
	select BR2_PACKAGE_EET
	select BR2_PACKAGE_EVAS
	help
	  Ecore is the Enlightenment core event abstraction layer library.

	  http://www.enlightenment.org/
```

## buildroot/package/edje/Config.in
```kconfig
config BR2_PACKAGE_EDJE
	bool "edje"
	default n
	select BR2_PACKAGE_EINA
	select BR2_PACKAGE_EET
	select BR2_PACKAGE_EVAS
	select BR2_PACKAGE_ECORE
	select BR2_PACKAGE_EMBRYO
	help
	  Edje is the Enlightenment graphical layout and animation library.

	  http://www.enlightenment.org/
```

## buildroot/package/eet/Config.in
```kconfig
config BR2_PACKAGE_EET
	bool "eet"
	default n
	select BR2_PACKAGE_EINA
	help
	  EET is the Enlightenment library for speedy data storage, retrieval, and compression.

	  http://www.enlightenment.org/
```

## buildroot/package/eina/Config.in
```kconfig
config BR2_PACKAGE_EINA
	bool "eina"
	default n
	help
	  Eina is the Enlightenment library that implements fast data types and miscellaneous tools.

	  http://www.enlightenment.org/
```

## buildroot/package/elementary/Config.in
```kconfig
config BR2_PACKAGE_ELEMENTARY
	bool "elementary"
	default n
	select BR2_PACKAGE_EINA
	select BR2_PACKAGE_EET
	select BR2_PACKAGE_EVAS
	select BR2_PACKAGE_ECORE
	select BR2_PACKAGE_EMBRYO
	select BR2_PACKAGE_EDJE
	select BR2_PACKAGE_E_DBUS
	help
	  Elementary is the Enlightenment widget toolkit designed for touchscreen uses.

	  http://www.enlightenment.org/
```

## buildroot/package/elinks/Config.in
```kconfig
config BR2_PACKAGE_ELINKS
	bool "elinks"
	default n
	help
	  Enhanced links, which is a graphics and text mode WWW browser (kind of like lynx).

	  http://elinks.or.cz/
```

## buildroot/package/embryo/Config.in
```kconfig
config BR2_PACKAGE_EMBRYO
	bool "embryo"
	default n
	help
	  Embryo is the Enlightenment library that loads and controls programs compiled in Small.

	  http://www.enlightenment.org/
```

## buildroot/package/evas/Config.in
```kconfig
config BR2_PACKAGE_EVAS
	bool "evas"
	default n
	select BR2_PACKAGE_EINA
	select BR2_PACKAGE_EET
	help
	  Evas is the Enlightenment canvas library.

	  http://www.enlightenment.org/
```

## buildroot/package/ffmpeg/Config.in
```kconfig
config BR2_PACKAGE_FFMPEG
	bool "ffmpeg"
	depends on BR2_PACKAGE_ZLIB 
	depends on BR2_PACKAGE_LIBFAAC 
	depends on BR2_PACKAGE_LIBFAAD2
	default n
	help
	 ffmpeg
```

## buildroot/package/ffmpeg_tiny/Config.in
```kconfig
config BR2_PACKAGE_FFMPEG_TINY
	bool "ffmpeg_tiny"
	default n
	help

	http://ffmpeg.sourceforge.net/index.php
```

## buildroot/package/fuse/Config.in
```kconfig
config BR2_PACKAGE_FUSE
	bool "fuse"
	default n
 	help
          The _F_ile system in _USE_rspace package. 
	  http://fuse.sourceforge.net/
```

## buildroot/package/fusesmb/Config.in
```kconfig
config BR2_PACKAGE_FUSESMB
	bool "fusesmb"
	default n
	select BR2_PACKAGE_FUSE
	select BR2_PACKAGE_SAMBA
	help

	http://www.ricardis.tudelft.nl/~vincent/fusesmb/
```

## buildroot/package/gd/Config.in
```kconfig
config BR2_PACKAGE_GD
	bool "libgd"
	default n
	depends on BR2_PACKAGE_JPEG
	depends on BR2_PACKAGE_LIBPNG
	depends on BR2_PACKAGE_FONTCONFIG
	help
		Library for the dynamic creation of images.
```

## buildroot/package/gnutls/Config.in
```kconfig
config BR2_PACKAGE_GNUTLS
	bool "gnutls"
	default n
	help
	  gnuTLS, The GNU Transport Layer Security Library 
```

## buildroot/package/hostapd/Config.in
```kconfig
config BR2_PACKAGE_HOSTAPD
	bool "hostapd"
	default n
	help
		hostapd : simulates access point
```

## buildroot/package/iconv/Config.in
```kconfig
config BR2_PACKAGE_ICONV
	bool "iconv"
	default n
	help
	  A character encoding conversion library

	  http://www.libtom.org/
```

## buildroot/package/libarchos_support/Config.in
```kconfig
config BR2_PACKAGE_LIBARCHOS_SUPPORT
        bool "libarchos_support"
        default n
        help
        Archos support library for external (Qt applications), which includes a vkeyboard implementation.
```
