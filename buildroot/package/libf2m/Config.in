## buildroot/package/libf2m/Config.in
```kconfig
config BR2_PACKAGE_LIBF2M
        bool "libf2m"
        default n
        help
        Transcode FLV-H263 to MPEG4
```

## buildroot/package/libgif/Config.in
```kconfig
config BR2_PACKAGE_LIBGIF
	bool "libgif"
	default n
	help
	  Library for handling pictures images.
```

## buildroot/package/libgsf/Config.in
```kconfig
config BR2_PACKAGE_LIBGSF
	bool "libgsf"
	default n
	depends on BR2_PACKAGE_LIBXML2
	depends on BR2_PACKAGE_LIBGLIB2
	depends on BR2_PACKAGE_ZLIB
	help
		'libgsf' is a simple i/o library that can read and write common file types and handle structured formats that provide file-system-in-a-file semantics.
		Used by wv
```

## buildroot/package/libmms/Config.in
```kconfig
config BR2_PACKAGE_LIBMMS
        bool "libmms"
        default n
        help
        MMS streaming support
```

## buildroot/package/libtfm/Config.in
```kconfig
config BR2_PACKAGE_LIBTOMFASTMATH
	bool "libtfm"
	default n
	help
	  A system-independent library for user-level network packet capture.

	  http://www.libtom.org/
```

## buildroot/package/libtomcrypt/Config.in
```kconfig
config BR2_PACKAGE_LIBTOMCRYPT
	bool "libtomcrypt"
	default n
	help
	  A system-independent library for user-level network packet capture.

	  http://www.libtom.org/
```

## buildroot/package/libupnp/Config.in
```kconfig
config BR2_PACKAGE_LIBUPNP
	bool "libupnp"
	default n
	help
	  The Portable UPnP SDK/Library
```

## buildroot/package/libusb1/Config.in
```kconfig
config BR2_PACKAGE_LIBUSB1
	bool "libusb1"
	default n
	help
	  Userspace library for accessing USB devices
	  libusb-1.0 is an almost-rewrite of the previous stable branch, libusb-0.1.

	  http://www.libusb.org/wiki/Libusb1.0
```

## buildroot/package/libvformat/Config.in
```kconfig
config BR2_PACKAGE_LIBVFORMAT
	bool "libvformat"
	default y
	help
		Library to parse/write vCard 3.0 (RFC 2425 and 2426)
		http://sourceforge.net/projects/vformat/
```

## buildroot/package/libwmf/Config.in
```kconfig
config BR2_PACKAGE_LIBWMF
	bool "libwmf"
	default n
	depends on BR2_PACKAGE_FREETYPE
	depends on BR2_PACKAGE_LIBXML2
	depends on BR2_PACKAGE_ZLIB
	depends on BR2_PACKAGE_JPEG
	depends on BR2_PACKAGE_LIBPNG
	depends on BR2_PACKAGE_EXPAT
	help
		A library for reading vector images in Microsoft's native Windows Metafile Format (WMF).
		http://wvware.sourceforge.net/
```

## buildroot/package/libzip/Config.in
```kconfig
config BR2_PACKAGE_LIBZIP
	bool "libzip"
	default n
	help
	  libzip is a C library for reading, creating, and modifying zip archives.
	  Files can be added from data buffers, files, or compressed data copied
	  directly from other zip archives.

	  http://www.nih.at/libzip/
```

## buildroot/package/linuxtv-dvb-apps/Config.in
```kconfig
config BR2_PACKAGE_LINUXTV-DVB-APPS
bool "linuxtv-dvb-apps"
	default y
	help
		http://www.linuxtv.org
```

## buildroot/package/mkdosfs/Config.in
```kconfig
config BR2_PACKAGE_DOSFSTOOLS
	bool "dosfstools"
	default n
	help
	  Utilities to create and check MS-DOS filesystems under Linux
	  (mkdosfs and dosfsck)

	  ftp://ftp.uni-erlangen.de/pub/Linux/LOCAL/dosfstools/

config BR2_PACKAGE_DOSFSTOOLS_MKDOSFS
	bool "mkdosfs"
	default n
	depends on BR2_PACKAGE_DOSFSTOOLS

config BR2_PACKAGE_DOSFSTOOLS_MKDOSFS_STATIC
	bool "mkdosfs_static"
	default n
	depends on BR2_PACKAGE_DOSFSTOOLS

config BR2_PACKAGE_DOSFSTOOLS_DOSFSCK
	bool "dosfsck"
	default n
	depends on BR2_PACKAGE_DOSFSTOOLS

config BR2_PACKAGE_DOSFSTOOLS_DOSFSCK_STATIC
	bool "dosfsck_static"
	default n
	depends on BR2_PACKAGE_DOSFSTOOLS
```

## buildroot/package/mtd/Config.in
```kconfig
menuconfig BR2_PACKAGE_MTD
	bool "mtd/jffs2/ubi utilities"
	default n
	select BR2_PACKAGE_ZLIB
	help
	  Build mtd/jffs/ubi utilities

if BR2_PACKAGE_MTD
choice
	prompt "Source package selection"
	depends on BR2_PACKAGE_MTD
	default BR2_PACKAGE_MTD20061007

config BR2_PACKAGE_MTD_UTILS
	bool "Use MTD-utils"
	depends on BR2_PACKAGE_MTD
	select BR2_PACKAGE_LZO
	help
	  Build mtd/jffs utilities with Dataflash support

config BR2_PACKAGE_MTD_UTILS_GIT
        bool "Use MTD-utils (GIT snapshot)"
	depends on BR2_PACKAGE_MTD
	select BR2_PACKAGE_LZO
	help
	  Build mtd/jffs utilities with Dataflash support

config BR2_PACKAGE_MTD_20061007
	bool "Use MTD from (20061007)"
	depends on BR2_PACKAGE_MTD
	help
	  Build mtd/jffs utilities with Dataflash support

config BR2_PACKAGE_MTD_20050122
	bool "Use MTD from (20050122)"
	help
	  Use the stable release.

config BR2_PACKAGE_MTD_SNAPSHOT
	bool "Daily snapshot"
	help
	  Use the latest MTD daily snapshot instead of release.
	  You should probably say NO except for specific purpose.

endchoice

config BR2_PACKAGE_MTD_SNAPSHOT_STRING
	string	"mtd_YYYYMMDD.orig.tar.gz"
	depends on BR2_PACKAGE_MTD_SNAPSHOT
	help
	  You should not modify the file name, unless you want to
	  use a specific and private MTD package.

config BR2_PACKAGE_MTD_ORIG_STRING
	string
	depends on BR2_PACKAGE_MTD_ORIG
	default "mtd-utils-1.1.0.tar.bz2" if BR2_PACKAGE_MTD_UTILS
	default "mtd_20061007.orig.tar.gz" if BR2_PACKAGE_MTD_20050122
	default "mtd_20050122.orig.tar.gz" if BR2_PACKAGE_MTD_20050122
	default $(BR2_PACKAGE_MTD_SNAPSHOT_STRING) if BR2_PACKAGE_MTD_SNAPSHOT

config BR2_PACKAGE_MTD_STATIC
	bool "Statically compile MTD-utils"
	depends on BR2_PACKAGE_MTD
	help
	  Statically compile mtd utilities.

menu "MTD tools selection"
	depends BR2_PACKAGE_MTD

config BR2_PACKAGE_MTD_FLASH_ERASE
	bool "flash_erase"
	default y
	depends on BR2_PACKAGE_MTD

config BR2_PACKAGE_MTD_FLASH_ERASEALL
	bool "flash_eraseall"
	default y
	depends on BR2_PACKAGE_MTD

config BR2_PACKAGE_MTD_FLASH_INFO
	bool "flash_info"
	default y
	depends on BR2_PACKAGE_MTD

config BR2_PACKAGE_MTD_FLASH_LOCK
	bool "flash_lock"
	default y
	depends on BR2_PACKAGE_MTD

config BR2_PACKAGE_MTD_FLASH_UNLOCK
	bool "flash_unlock"
	default y
	depends on BR2_PACKAGE_MTD

config BR2_PACKAGE_MTD_FLASHCP
	bool "flashcp"
	default y
	depends on BR2_PACKAGE_MTD

config BR2_PACKAGE_MTD_ERASE
	bool "erase"
	default y
	depends on BR2_PACKAGE_MTD

config BR2_PACKAGE_MTD_JFFS2DUMP
	bool "jffs2dump"
	default y
	depends on BR2_PACKAGE_MTD

config BR2_PACKAGE_MTD_JFFS3DUMP
	bool "jffs3dump"
	default y
	depends on BR2_PACKAGE_MTD
	depends on !BR2_PACKAGE_MTD_20061007

config BR2_PACKAGE_MTD_SUMTOOL
	bool "sumtool"
	default y
	depends on BR2_PACKAGE_MTD

config BR2_PACKAGE_MTD_FTL_CHECK
	bool "ftl_check"
	default y
	depends on BR2_PACKAGE_MTD

config BR2_PACKAGE_MTD_FTL_FORMAT
	bool "ftl_format"
	default y
	depends on BR2_PACKAGE_MTD

config BR2_PACKAGE_MTD_NFTL_FORMAT
	bool "nftl_format"
	default y
	depends on BR2_PACKAGE_MTD

config BR2_PACKAGE_MTD_NFTLDUMP
	bool "nftldump"
	default y
	depends on BR2_PACKAGE_MTD

config BR2_PACKAGE_MTD_MKFSJFFS2
	bool "mkfs.jffs2"
	default y
	depends on BR2_PACKAGE_MTD

config BR2_PACKAGE_MTD_MKFSJFFS
	bool "mkfs.jffs"
	default y
	depends on BR2_PACKAGE_MTD

config BR2_PACKAGE_MTD_NANDDUMP
	bool "nanddump"
	default y
	depends on BR2_PACKAGE_MTD

config BR2_PACKAGE_MTD_NANDWRITE
	bool "nandwrite"
	default y
	depends on BR2_PACKAGE_MTD

config BR2_PACKAGE_MTD_MTD_DEBUG
	bool "mtd_debug"
	default y
	depends on BR2_PACKAGE_MTD

config BR2_PACKAGE_MTD_DOCFDISK
	bool "docfdisk"
	default y
	depends on BR2_PACKAGE_MTD

config BR2_PACKAGE_MTD_DOC_LOADBIOS
	bool "doc_loadbios"
	default y
	depends on BR2_PACKAGE_MTD

comment UBI-tools

config BR2_PACKAGE_MTD_MKFSUBIFS
        bool "mkfs.ubifs"
        default y
        depends on BR2_PACKAGE_MTD

config BR2_PACKAGE_MTD_UBIATTACH
	bool "ubiattach"
	default y
	depends on BR2_PACKAGE_MTD

config BR2_PACKAGE_MTD_UBIDETACH
	bool "ubidetach"
	default y
	depends on BR2_PACKAGE_MTD

config BR2_PACKAGE_MTD_UBICRC32
	bool "ubicrc32"
	default y
	depends on BR2_PACKAGE_MTD

config BR2_PACKAGE_MTD_UBIFORMAT
	bool "ubiformat"
	default y
	depends on BR2_PACKAGE_MTD

config BR2_PACKAGE_MTD_UBINFO
	bool "ubinfo"
	default y
	depends on BR2_PACKAGE_MTD

config BR2_PACKAGE_MTD_UBINIZE
	bool "ubinize"
	default y
	depends on BR2_PACKAGE_MTD

config BR2_PACKAGE_MTD_UBIMKVOL
	bool "ubimkvol"
	default y
	depends on BR2_PACKAGE_MTD

config BR2_PACKAGE_MTD_UBIRMVOL
	bool "ubirmvol"
	default y
	depends on BR2_PACKAGE_MTD

config BR2_PACKAGE_MTD_UBIUPDATEVOL
	bool "ubiupdatevol"
	default y
	depends on BR2_PACKAGE_MTD
endmenu

endif
```

## buildroot/package/nbtscan/Config.in
```kconfig
config BR2_PACKAGE_NBTSCAN
	bool "nbtscan"
	default n
	help

	http://unixwiz.net/tools/index.html
```

## buildroot/package/opencore-amr/Config.in
```kconfig
config BR2_PACKAGE_OPENCORE_AMR
	bool "opencore-amr"
	default n
	help
	  Library of OpenCORE Framework implementation of Adaptive Multi Rate Narrowband and Wideband speech codec 

	  http://opencore-amr.sourceforge.net/
```

## buildroot/package/oprofile/Config.in
```kconfig
config BR2_PACKAGE_OPROFILE
	bool "oprofile"
	default n
	select BR2_PACKAGE_BASH
	help
	    oprofile system profiler

config BR2_OPROFILE_INSTALL_ON_OPT
	bool "  install on /opt"
	depends BR2_PACKAGE_OPROFILE
	default n
	help
	    install oprofile on /opt filesystem
```

## buildroot/package/pidgin/Config.in
```kconfig
config BR2_PACKAGE_PIDGIN
        bool "pidgin"
	default n
	help
	    Pidgin is an IM providing several protocols thanks to the library libpurple.
	    http://www.pidgin.im
	  
```

## buildroot/package/poppler/Config.in
```kconfig
config BR2_PACKAGE_POPPLER
        bool "poppler"
        default n
        select BR2_PACKAGE_FONTCONFIG
        select BR2_PACKAGE_QTE
        select BR2_QTE_VERSION_2_3_10
        help
        Poppler is a Xpdf based pdf rendering library. Beware you must
        have avx/poppler checked out for this to actually work.
```

## buildroot/package/proftpd-static/Config.in
```kconfig
config BR2_PACKAGE_PROFTPD_STATIC
	bool "proftpd-static"
	default n
	help
	  ProFTPD, a highly configurable FTP server.

	  This will use a statically-built version (compiled with GCC 4.4.0).
```

## buildroot/package/refdbg-camel/Config.in
```kconfig
config BR2_PACKAGE_REFDBG_CAMEL
	bool "refdbg-camel"
	default n
	help
		Library to help debug refcounts in camel
		http://refdbg.sourceforge.net
```

## buildroot/package/refdbg/Config.in
```kconfig
config BR2_PACKAGE_REFDBG
	bool "refdbg"
	default n
	help
		Library to help debug refcounts in glib2
		http://refdbg.sourceforge.net
```

## buildroot/package/samba-static/Config.in
```kconfig
config BR2_PACKAGE_SAMBA_STATIC
	bool "samba-static"
	default n
	help
	  Samba is a suite implementing SMB/CIFS protocols.

	  This will use a statically-built version (compiled with GCC 4.4.1).
```
