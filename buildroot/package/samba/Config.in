## buildroot/package/samba/Config.in
```kconfig
config BR2_PACKAGE_SAMBA
	bool "samba"
	default n
	help

	Installs the smbd and the nmbd from the samba package.
```

## buildroot/package/sdparm/Config.in
```kconfig
config BR2_PACKAGE_SDPARM
	bool "sdparm"
	default n
	help
	  sdparm - get/set hard disk parameters for SCSI drives.

	  http://sg.torque.net/sg/sdparm.html
```

## buildroot/package/sshfs/Config.in
```kconfig
config BR2_PACKAGE_SSHFS
        bool "sshfs"
	depends BR2_PACKAGE_FUSE
	default n
	help
		support fuse for a ssh filesystem (http://fuse.sourceforge.net/sshfs.html)
		Warning ! the fuse module will implicitly build the openssh package.
			
```

## buildroot/package/tinymail/Config.in
```kconfig
config BR2_PACKAGE_TINYMAIL
	bool "tinymail"
	default n
	help
		Library to manage e-mail backends
		http://www.tinymail.org
```

## buildroot/package/tremor/Config.in
```kconfig
config BR2_PACKAGE_TREMOR
	bool "tremor"
	default n
	help
	  Fixed Point Vorbis decoder
```

## buildroot/package/tzdata/Config.in
```kconfig
config BR2_PACKAGE_TZDATA
	bool "tzdata"
	default n
	help
	  Timezone data package.
	  ftp://elsie.nci.nih.gov/pub/
```

## buildroot/package/wv/Config.in
```kconfig
config BR2_PACKAGE_WV
	bool "wv"
	default n
	depends on BR2_PACKAGE_LIBGSF
	help
		MSWord library can load and parse Word 2000, 97, 95 and 6 file formats
		http://wvware.sourceforge.net/
```

## buildroot/package/xlhtml/Config.in
```kconfig
config BR2_PACKAGE_XLHTML
	bool "xlhtml"
	default n
	help
		Contains the Excel (xlhtml) and Powerpoint (ppthtml) to html converters.
```

## buildroot/target/device/Arm/Config.in
```kconfig
menuconfig BR2_TARGET_ARM
	bool "ARM Ltd. Device Support"
	depends BR2_arm
	default n

comment "Arm based Device Support"
	depends BR2_arm && BR2_TARGET_ARM

config BR2_TARGET_ARM_INTEGRATOR_926
	bool "Integrator arm926"
	depends BR2_arm && BR2_TARGET_ARM
	default n
	select BR2_PACKAGE_LINUX
	select BR2_ARM_EABI
	select BR2_KERNEL_HEADERS_2_6_22
	select BR2_PTHREADS
	select BR2_arm926t
	help
	  An ARM integrator 926 board for use with qemu.
	  This one has an MMU.

config BR2_TARGET_ARM_OMAP3_3430SDP
	bool "OMAP3 3430SDP"
	depends BR2_arm && BR2_TARGET_ARM
	default n
	select BR2_PACKAGE_LINUX
	select BR2_ARM_EABI
	select BR2_KERNEL_HEADERS_2_6_22
	select BR2_PTHREADS
	select BR2_arm1176jzf_s
	help
	  An ARM OMAP3 3430 SDP board 
	  This one has an MMU.
```
